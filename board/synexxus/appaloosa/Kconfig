## board/synexxus/appaloosa/Kconfig
```kconfig
if TARGET_APPALOOSA

config SYS_BOARD
	default "appaloosa"

config SYS_VENDOR
	default "synexxus"

config SYS_SOC
	default "mx6"

config SYS_CONFIG_NAME
	default "appaloosa"

endif
```

## configs/synexxus_aristeus_defconfig
```kconfig
CONFIG_ARM=y
CONFIG_TARGET_ARISTEUS=y
CONFIG_SYS_EXTRA_OPTIONS="IMX_CONFIG=board/synvexxus/aristeus/aristeus.cfg,MX6Q,DDR_MB=1024,ARISTEUS,DEFAULT_FDT_FILE=\"imx6q_aristeus.dtb\""
# CONFIG_CMD_IMLS is not set
# CONFIG_CMD_FLASH is not set
CONFIG_SPI_FLASH=y
```
